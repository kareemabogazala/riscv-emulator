ENTRY(_start)

SECTIONS {
    . = 0x80010000;  /* Kernel base (KERNEL_BASE) */

    .text : {
        *(.text*)
    }

    .rodata : {
        *(.rodata*)
    }

    .data : {
        *(.data*)
    }

    .bss : {
        *(.bss*)
        *(COMMON)
    }
}
